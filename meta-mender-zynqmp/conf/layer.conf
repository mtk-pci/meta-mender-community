## meta-mender-zynqmp/conf/layer.conf
```bitbake
# We have a conf and classes directory, add to BBPATH
BBPATH .= ":${LAYERDIR}"

# We have recipes-* directories, add to BBFILES
BBFILES += "${LAYERDIR}/recipes-*/*/*.bb \
	${LAYERDIR}/recipes-*/*/*.bbappend"

BBFILE_COLLECTIONS += "mender-zynqmp"
BBFILE_PATTERN_mender-zynqmp = "^${LAYERDIR}/"
BBFILE_PRIORITY_mender-zynqmp = "7"

LAYERDEPENDS_mender-zynqmp = "mender"

LAYERSERIES_COMPAT_mender-zynqmp = "honister kirkstone"
```
